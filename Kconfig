## Kconfig
```kconfig
# Copyright (c) 2026 GALPANEL contributors
# SPDX-License-Identifier: MIT

menu "GALPANEL features"

config GALPANEL_ENDPOINT_LED
    bool "Use AUX LED to show the active output endpoint"
    depends on SHIELD_GALPANEL
    default y
    help
      Turn the AUX LED on while the currently selected HID endpoint is USB.
      Turn it off while the selected endpoint is BLE or no endpoint is ready.

config GALPANEL_STATUS_INDICATORS
    bool "Enable GALPANEL status indicators"
    depends on SHIELD_GALPANEL || SHIELD_GALPANEL_STATUS_TEST || SHIELD_GALPANEL_SAFETY_TEST
    default y
    select GPIO
    help
      Drive LINK, INFO, FN and AUX from ZMK state and provide the optional
      WARN long-press safety test.

config GALPANEL_LINK_ON_MS
    int "BLE LINK LED on time after connection (milliseconds)"
    depends on GALPANEL_STATUS_INDICATORS
    range 0 600000
    default 0
    help
      A value of zero keeps LINK on while connected. A positive value turns
      LINK off after that many milliseconds while preserving the connected
      state in firmware. The final GALPANEL firmware uses 30000.

config GALPANEL_PROFILE_NAMES
    bool "Use GALPANEL N names for BLE profiles"
    depends on SHIELD_GALPANEL || SHIELD_GALPANEL_STATUS_TEST || SHIELD_GALPANEL_SAFETY_TEST
    default y
    help
      Rename the active BLE advertising name to GALPANEL 1 through GALPANEL 5
      when the active profile changes.

config GALPANEL_SAFETY_TEST
    bool "Enable guarded GALPANEL SYS controls"
    depends on SHIELD_GALPANEL || SHIELD_GALPANEL_SAFETY_TEST
    default n
    help
      Own the SYS key so a tap selects the next BLE profile, a double tap
      toggles USB/BLE output, and a guarded six-second hold clears the current
      BLE profile bond with LED feedback.

config GALPANEL_NAME_RESET
    bool "Enable one-shot historical GALPANEL name reset"
    depends on SHIELD_GALPANEL_NAME_RESET
    default y
    help
      Write the historical static BLE name GALPANEL to the persistent
      settings area. This is a diagnostic/recovery image only.

endmenu
```

## config/boards/shields/galpanel/Kconfig.defconfig
```kconfig
# Copyright (c) 2026 GALPANEL contributors
# SPDX-License-Identifier: MIT

if SHIELD_GALPANEL

config ZMK_KEYBOARD_NAME
  default "GALPANEL"

endif # SHIELD_GALPANEL

if SHIELD_GALPANEL_LED_TEST

config ZMK_KEYBOARD_NAME
  default "GP LED TEST"

endif # SHIELD_GALPANEL_LED_TEST

if SHIELD_GALPANEL_LED_IND_TEST

config ZMK_KEYBOARD_NAME
  default "GP LED IND"

endif # SHIELD_GALPANEL_LED_IND_TEST

if SHIELD_GALPANEL_IO_TEST

config ZMK_KEYBOARD_NAME
  default "GP IO TEST"

endif # SHIELD_GALPANEL_IO_TEST

if SHIELD_GALPANEL_EC11_TEST

config ZMK_KEYBOARD_NAME
  default "GP EC11 TEST"

endif # SHIELD_GALPANEL_EC11_TEST

if SHIELD_GALPANEL_BLE_RECOVERY

config ZMK_KEYBOARD_NAME
  default "GP BLE REC"

endif # SHIELD_GALPANEL_BLE_RECOVERY

if SHIELD_GALPANEL_STATUS_TEST

config ZMK_KEYBOARD_NAME
  default "GP STATUS TEST"

endif # SHIELD_GALPANEL_STATUS_TEST

if SHIELD_GALPANEL_SAFETY_TEST

config ZMK_KEYBOARD_NAME
  default "GP SAFETY TEST"

endif # SHIELD_GALPANEL_SAFETY_TEST
```

## config/boards/shields/galpanel/Kconfig.shield
```kconfig
# Copyright (c) 2026 GALPANEL contributors
# SPDX-License-Identifier: MIT

config SHIELD_GALPANEL
  def_bool $(shields_list_contains,galpanel)

config SHIELD_GALPANEL_LED_TEST
  def_bool $(shields_list_contains,galpanel_led_test)

config SHIELD_GALPANEL_LED_IND_TEST
  def_bool $(shields_list_contains,galpanel_led_ind_test)

config SHIELD_GALPANEL_IO_TEST
  def_bool $(shields_list_contains,galpanel_io_test)

config SHIELD_GALPANEL_EC11_TEST
  def_bool $(shields_list_contains,galpanel_ec11_test)
```

## config/boards/shields/galpanel_ble_min/Kconfig.defconfig
```kconfig
if SHIELD_GALPANEL_BLE_MIN

config ZMK_KEYBOARD_NAME
  default "GALPANEL MIN"

endif
```

## config/boards/shields/galpanel_ble_min/Kconfig.shield
```kconfig
# GALPANEL BLE minimum isolation test.

config SHIELD_GALPANEL_BLE_MIN
  def_bool $(shields_list_contains,galpanel_ble_min)
```

## config/boards/shields/official_zmk_ble_test/Kconfig.defconfig
```kconfig
if SHIELD_OFFICIAL_ZMK_BLE_TEST

config ZMK_KEYBOARD_NAME
  default "ZMK BLE TEST"

endif
```

## config/boards/shields/official_zmk_ble_test/Kconfig.shield
```kconfig
# Upstream ZMK-only BLE isolation test.

config SHIELD_OFFICIAL_ZMK_BLE_TEST
  def_bool $(shields_list_contains,official_zmk_ble_test)
```
