/*
 * Windows BLE baseline: same physical key GPIOs, but no GALPANEL status LEDs,
 * encoder, dynamic Profile naming, or product-state application modules.
 */
#include "galpanel.overlay"

&galpanel_leds {
    status = "disabled";
};

&galpanel_encoder {
    status = "disabled";
};
