/* Upstream ZMK-only BLE isolation test. */

#include <behaviors.dtsi>
#include <dt-bindings/zmk/bt.h>
#include <dt-bindings/zmk/keys.h>

/ {
    keymap {
        compatible = "zmk,keymap";

        default_layer {
            bindings = <&kp A &bt BT_CLR_ALL>;
        };
    };
};
